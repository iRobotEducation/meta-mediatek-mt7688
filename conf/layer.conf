## conf/layer.conf
```bitbake
# We have a conf and classes directory, add to BBPATH
BBPATH .= ":${LAYERDIR}"

# We have a recipes-* directories, add to BBFILES
BBFILES += "${LAYERDIR}/recipes-*/*/*.bb \
	${LAYERDIR}/recipes-*/*/*.bbappend"

BBFILE_COLLECTIONS += "mediatek-mt7688"
BBFILE_PATTERN_mediatek-mt7688 = "^${LAYERDIR}/"
BBFILE_PRIORITY_mediatek-mt7688 = "6"
LAYERSERIES_COMPAT_mediatek-mt7688 = "thud warrior"
```

## conf/machine/linkit7688.conf
```bitbake
#@TYPE: Machine
#@NAME: linkit7688

#@DESCRIPTION: Machine configuration for linkit7688 systems

require conf/machine/include/mips/tune-mips-24k.inc
DEFAULTTUNE = "mips32r2-24kec"

MACHINE_FEATURES = "usbhost serial wifi"

KERNEL_IMAGETYPE = "vmlinux"
KERNEL_ALT_IMAGETYPE = "vmlinux.bin"
KERNEL_IMAGE_STRIP_EXTRA_SECTIONS  = ".comment"

PREFERRED_PROVIDER_virtual/kernel="linux-yocto-mt7688"
PREFERRED_VERSION_linux-yocto-mt7688 ?= "4.14%"
PREFERRED_VERSION_gdb = "8.0"

SERIAL_CONSOLE = "115200 ttyS2"
USE_VT ?= "0"

MACHINE_EXTRA_RRECOMMENDS = " kernel-modules"
DISTRO_FEATURES_append += " sysvinit wifi ipv4 ipv6"

#VIRTUAL-RUNTIME_init_manager_linkit7688 = "sysvinit sysvinit-pidof"
#VIRTUAL-RUNTIME_initscripts = "initscripts"
#VIRTUAL-RUNTIME_initscripts = "busybox"
MACHINE_FEATURES_BACKFILL_CONSIDERED += "rtc"

EXTRA_IMAGE_FEATURES += "read-only-rootfs"
IMAGE_ROOTFS_MAXSIZE="56000"
IMAGE_FSTYPES ?= "jffs2 tar.bz2"
JFFS2_ERASEBLOCK = "0x10000"

MACHINE_ESSENTIAL_EXTRA_RRECOMMENDS += "\
kernel-module-backports \
kernel-module-mt76 \
kernel-module-mt7603e \
kernel-module-mt76x2e \
"

KERNEL_MODULE_AUTOLOAD += "mt7603e \
                           mt76 \
                           scsi_mod sd_mod \
                           usb-storage \
                           ehci-platform \
                           rndis-host \
                           pegasus \
                           asix \
                           cdc_ether \
                           plusb \
                           r8152 \
                           rtl8150 \
                           lan78xx \
                           kaweth \
                           i2c-dev \
                           i2c-mt7621 \
                           mtk_sd \
 			   snd-soc-ralink-i2s \
 			   snd-soc-wm8960 \
 			   snd-soc-simple-card \
 			   snd-timer \
 			   snd-pcm-dmaengine \
                           "

RDEPENDS_${KERNEL_PACKAGE_NAME}-base = ""

IROBOT_ARTIFACTORY_BASE_URL ?= "https://artifactory.wardrobe.irobot.com/artifactory"

# Little Endian
TUNE_FEATURES_tune-mips-nf = "o32"

UBINIZE_PARAMS = "-m 1 -p 0x10000 -O 4096"
INHERIT += "buildhistory"
BUILDHISTORY_COMMIT = "1"
SOURCE_MIRROR_URL ?= "${IROBOT_ARTIFACTORY_BASE_URL}/oe-packages/"
PACKAGE_FEED_URIS = "http://neptune.wardrobe.irobot.com/daredevil"
INHERIT += "own-mirrors"
BB_GENERATE_MIRROR_TARBALLS = "1"
# Default to setting automatically based on cpu count
BB_NUMBER_THREADS = "${@oe.utils.cpu_count()}"
# Default to setting automatically based on cpu count
PARALLEL_MAKE = "-j ${@oe.utils.cpu_count()}"
VERSION ?= "0.1.0"
PRODUCT ?= "robot"
PRODUCT_VERSION ?= "0.1.0"
ROBOT ?= "generic"
JOB_BASE_NAME ?= "sandbox"
BUILD_NUMBER ?= "000"
BASENAME = "${ROBOT}+${PRODUCT_VERSION}+${JOB_BASE_NAME}+${BUILD_NUMBER}"
OVERRIDES += ":${PRODUCT}:${ROBOT}"
BUILDCFG_VARS += "ROBOT"
```

## conf/machine/sundial.conf
```bitbake
#@TYPE: Machine
#@NAME: sundial

#@DESCRIPTION: Machine configuration for sundial boards

require conf/machine/include/mips/tune-mips-24k.inc
DEFAULTTUNE = "mips32r2-24kec"

MACHINE_FEATURES = "usbhost serial wifi"

KERNEL_IMAGETYPE = "vmlinux"
KERNEL_ALT_IMAGETYPE = "vmlinux.bin"
KERNEL_IMAGE_STRIP_EXTRA_SECTIONS  = ".comment"

PREFERRED_PROVIDER_u-boot-fw-utils="u-boot-fw-utils"
PREFERRED_PROVIDER_virtual/kernel="linux-yocto-mt7688"
PREFERRED_VERSION_linux-yocto-mt7688 ?= "4.14%"
PREFERRED_VERSION_gdb = "8.3"
PREFERRED_VERSION_swupdate = "git"

PREFERRED_VERSION_libssh="0.8.9"

SERIAL_CONSOLE = "115200 ttyS1"
USE_VT ?= "0"

MACHINE_EXTRA_RRECOMMENDS = " kernel-modules"
DISTRO_FEATURES_append += " sysvinit wifi ipv4 ipv6 xattr"

MACHINE_FEATURES_BACKFILL_CONSIDERED += "rtc"

EXTRA_IMAGE_FEATURES += "read-only-rootfs"
IMAGE_ROOTFS_MAXSIZE="140000"
IMAGE_FSTYPES ?= "jffs2 tar.bz2"
JFFS2_ERASEBLOCK = "0x10000"

MACHINE_ESSENTIAL_EXTRA_RRECOMMENDS += "\
kernel-module-mt-wifi \
kernel-module-mt7603e \
kernel-module-mt76x2e \
"

KERNEL_MODULE_AUTOLOAD += "mt7603e \
                           mt_wifi \
                           scsi_mod sd_mod \
                           usb-storage \
                           ehci-platform \
                           rndis-host \
                           pegasus \
                           asix \
                           cdc_ether \
                           plusb \
                           r8152 \
                           rtl8150 \
                           lan78xx \
                           kaweth \
                           i2c-dev \
                           i2c-mt7621 \
                           mtk_sd \
 			   snd-soc-ralink-i2s \
			   cdc_ncm \
                           "

RDEPENDS_${KERNEL_PACKAGE_NAME}-base = ""

# Don't bundle the initramfs in the kernel.  Build it separately.
#INITRAMFS_IMAGE_BUNDLE="1"

# We have cleverly selected the name "initramfs" for our initramfs image.
INITRAMFS_IMAGE="initramfs"
INITRAMFS_FSTYPES="cpio.lzma"

# Little Endian
TUNE_FEATURES_tune-mips-nf = "o32"
# Disable building u-boot-fw-utils for Sundial. It requires a _defconfig file in the u-boot source tree, but we maintain our _defconfig files in the Yocto source tree. Plus, we don't need u-boot-fw-utils for Sundial.
RDEPENDS_packagegroup-irobot-oe-utils_remove += "u-boot-fw-utils"

IROBOT_ARTIFACTORY_BASE_URL ?= "https://artifactory.wardrobe.irobot.com/artifactory"

INHERIT += "buildhistory"
BUILDHISTORY_COMMIT = "1"
SOURCE_MIRROR_URL ?= "${IROBOT_ARTIFACTORY_BASE_URL}/oe-packages/"
PACKAGE_FEED_URIS = "http://neptune.wardrobe.irobot.com/daredevil"
INHERIT += "own-mirrors"
BB_GENERATE_MIRROR_TARBALLS = "1"
# Default to setting automatically based on cpu count
BB_NUMBER_THREADS = "${@oe.utils.cpu_count()}"
# Default to setting automatically based on cpu count
PARALLEL_MAKE = "-j ${@oe.utils.cpu_count()}"
VERSION ?= "4.0.5"
PRODUCT ?= "robot"
PRODUCT_VERSION ?= "0.0.0"
ROBOT ?= "daredevil"
JOB_BASE_NAME ?= "sandbox"
BUILD_NUMBER ?= "0"
BASENAME = "${ROBOT}+${PRODUCT_VERSION}+${JOB_BASE_NAME}+${BUILD_NUMBER}"
OVERRIDES += ":${PRODUCT}:${ROBOT}"
BUILDCFG_VARS += "ROBOT"
```

## recipes-bsp/u-boot/u-boot-mediatek/sundial/sundial_defconfig
```kconfig
CONFIG_MIPS=y
CONFIG_SPL_LIBCOMMON_SUPPORT=y
CONFIG_SPL_LIBGENERIC_SUPPORT=y
CONFIG_SPL_SERIAL_SUPPORT=y
CONFIG_SPL_SYS_MALLOC_F_LEN=0x20000
CONFIG_NR_DRAM_BANKS=1
CONFIG_SPL=y
CONFIG_ARCH_MTMIPS=y
CONFIG_BOARD_IROBOT_7688=y
CONFIG_RESTORE_EXCEPTION_VECTOR_BASE=y
# CONFIG_MIPS_BOOT_CMDLINE_LEGACY is not set
# CONFIG_MIPS_BOOT_ENV_LEGACY is not set
CONFIG_MIPS_BOOT_FDT=y
# CONFIG_LOCALVERSION_AUTO is not set
CONFIG_FIT=y
CONFIG_FIT_SIGNATURE=y
CONFIG_FIT_SIGNATURE_MAX_SIZE=0x2000000
CONFIG_FIT_ENABLE_RSASSA_PSS_SUPPORT=y
# CONFIG_ARCH_FIXUP_FDT_MEMORY is not set
CONFIG_BOOTDELAY=-2
CONFIG_USE_BOOTCOMMAND=y
CONFIG_LOGLEVEL=0
CONFIG_SYS_CONSOLE_INFO_QUIET=y
CONFIG_LOG_DEFAULT_LEVEL=0
# CONFIG_DISPLAY_BOARDINFO is not set
CONFIG_SPL_SYS_MALLOC_SIMPLE=y
CONFIG_HUSH_PARSER=y
# CONFIG_CMDLINE_EDITING is not set
# CONFIG_AUTO_COMPLETE is not set
# CONFIG_SYS_LONGHELP is not set
# CONFIG_CMD_BDI is not set
# CONFIG_CMD_CONSOLE is not set
# CONFIG_CMD_BOOTD is not set
# CONFIG_CMD_ELF is not set
# CONFIG_CMD_FDT is not set
# CONFIG_CMD_GO is not set
# CONFIG_CMD_IMI is not set
# CONFIG_CMD_XIMG is not set
# CONFIG_CMD_EXPORTENV is not set
# CONFIG_CMD_IMPORTENV is not set
# CONFIG_CMD_EDITENV is not set
# CONFIG_CMD_SAVEENV is not set
# CONFIG_CMD_ENV_EXISTS is not set
# CONFIG_CMD_CRC32 is not set
# CONFIG_CMD_MEMORY is not set
# CONFIG_CMD_DM is not set
# CONFIG_CMD_FLASH is not set
CONFIG_CMD_GPIO=y
# CONFIG_CMD_LOADB is not set
# CONFIG_CMD_LOADS is not set
# CONFIG_CMD_PINMUX is not set
CONFIG_CMD_USB=y
# CONFIG_CMD_ECHO is not set
# CONFIG_CMD_SOURCE is not set
# CONFIG_CMD_SETEXPR is not set
CONFIG_CMD_IMPORT_RSA_KEYS=y
CONFIG_CMD_FAT=y
CONFIG_MTDIDS_DEFAULT="spi-nand0=spi0.1"
CONFIG_MTDPARTS_DEFAULT="spi0.1:-(nand)"
CONFIG_CMD_UBI=y
# CONFIG_CMD_UBIFS is not set
# CONFIG_SPL_DOS_PARTITION is not set
# CONFIG_ISO_PARTITION is not set
CONFIG_DEFAULT_DEVICE_TREE="sundial"
CONFIG_USE_DEFAULT_ENV_FILE=y
CONFIG_DEFAULT_ENV_FILE="sundial_env"
# CONFIG_NET is not set
# CONFIG_DM_WARN is not set
# CONFIG_DM_DEVICE_REMOVE is not set
# CONFIG_DM_STDIO is not set
# CONFIG_DM_SEQ_ALIAS is not set
# CONFIG_INPUT is not set
CONFIG_MTD=y
CONFIG_MTD_DEVICE=y
CONFIG_MTD_SPI_NAND=y
# CONFIG_DM_SPI_FLASH is not set
# CONFIG_DM_ETH is not set
CONFIG_PHY=y
CONFIG_MT76X8_USB_PHY=y
CONFIG_PINCTRL=y
CONFIG_PINCONF=y
CONFIG_PINCTRL_MT7628=y
CONFIG_CONS_INDEX=2
CONFIG_MTK_SERIAL=y
CONFIG_SPI=y
CONFIG_MT7621_SPI=y
CONFIG_USB=y
CONFIG_DM_USB=y
CONFIG_USB_EHCI_HCD=y
CONFIG_USB_EHCI_GENERIC=y
CONFIG_USB_STORAGE=y
CONFIG_WDT=y
CONFIG_WDT_MT7621=y
CONFIG_LZMA=y
CONFIG_LZO=y
CONFIG_SPL_LZMA=y
```

## recipes-bsp/u-boot/u-boot/sundial_defconfig
```kconfig
# Sundial ROM/FLASH defconfig, optimized for size and silence
CONFIG_MIPS=y
CONFIG_SYS_TEXT_BASE=0x9c000000
CONFIG_ARCH_MT7620=y
CONFIG_BOARD_LINKIT_SMART_7688=y
CONFIG_BOOT_ROM=y
CONFIG_ONBOARD_DDR2_SIZE_512MBIT=y
CONFIG_ONBOARD_DDR2_CHIP_WIDTH_16BIT=y
# CONFIG_MIPS_BOOT_CMDLINE_LEGACY is not set
# CONFIG_MIPS_BOOT_ENV_LEGACY is not set
CONFIG_MIPS_BOOT_FDT=y
# CONFIG_LOCALVERSION_AUTO is not set
CONFIG_NR_DRAM_BANKS=1
# CONFIG_SYS_MALLOC_CLEAR_ON_INIT is not set
CONFIG_FIT=y
CONFIG_FIT_SIGNATURE=y
CONFIG_FIT_SIGNATURE_MAX_SIZE=0x2000000
CONFIG_FIT_ENABLE_RSASSA_PSS_SUPPORT=y
# CONFIG_ARCH_FIXUP_FDT_MEMORY is not set
CONFIG_USE_BOOTCOMMAND=y
CONFIG_LOGLEVEL=0
CONFIG_SYS_CONSOLE_INFO_QUIET=y
CONFIG_LOG_DEFAULT_LEVEL=0
# CONFIG_DISPLAY_BOARDINFO is not set
CONFIG_BOARD_EARLY_INIT_F=y
CONFIG_HUSH_PARSER=y
# CONFIG_CMDLINE_EDITING is not set
# CONFIG_AUTO_COMPLETE is not set
# CONFIG_SYS_LONGHELP is not set
# CONFIG_CMD_BDI is not set
# CONFIG_CMD_CONSOLE is not set
# CONFIG_CMD_BOOTD is not set
# CONFIG_CMD_ELF is not set
# CONFIG_CMD_FDT is not set
# CONFIG_CMD_GO is not set
# CONFIG_CMD_IMI is not set
# CONFIG_CMD_XIMG is not set
# CONFIG_CMD_EXPORTENV is not set
# CONFIG_CMD_IMPORTENV is not set
# CONFIG_CMD_EDITENV is not set
# CONFIG_CMD_SAVEENV is not set
# CONFIG_CMD_ENV_EXISTS is not set
# CONFIG_CMD_CRC32 is not set
# CONFIG_CMD_MEMORY is not set
# CONFIG_CMD_DM is not set
# CONFIG_CMD_FLASH is not set
CONFIG_CMD_GPIO=y
# CONFIG_CMD_LOADB is not set
# CONFIG_CMD_LOADS is not set
CONFIG_CMD_USB=y
# CONFIG_CMD_ECHO is not set
# CONFIG_CMD_SOURCE is not set
# CONFIG_CMD_SETEXPR is not set
CONFIG_CMD_IMPORT_RSA_KEYS=y
CONFIG_CMD_FAT=y
CONFIG_MTDIDS_DEFAULT="spi-nand0=spi0.1"
CONFIG_MTDPARTS_DEFAULT="spi0.1:-(nand)"
CONFIG_CMD_UBI=y
# CONFIG_CMD_UBIFS is not set
# CONFIG_ISO_PARTITION is not set
CONFIG_DEFAULT_DEVICE_TREE="sundial"
CONFIG_USE_DEFAULT_ENV_FILE=y
CONFIG_DEFAULT_ENV_FILE="sundial_env"
# CONFIG_NET is not set
# CONFIG_DM_WARN is not set
# CONFIG_DM_DEVICE_REMOVE is not set
# CONFIG_DM_STDIO is not set
# CONFIG_DM_SEQ_ALIAS is not set
# CONFIG_INPUT is not set
CONFIG_MTD=y
CONFIG_MTD_DEVICE=y
CONFIG_MTD_SPI_NAND=y
# CONFIG_DM_SPI_FLASH is not set
# CONFIG_DM_ETH is not set
CONFIG_PHY=y
CONFIG_MT76X8_USB_PHY=y
CONFIG_RAM=y
CONFIG_DM_RESET=y
# CONFIG_REQUIRE_SERIAL_CONSOLE is not set
# CONFIG_SPL_SERIAL_PRESENT is not set
CONFIG_SYS_NS16550=y
CONFIG_SPI=y
CONFIG_MT7621_SPI=y
CONFIG_SYSRESET_SYSCON=y
CONFIG_USB=y
CONFIG_DM_USB=y
CONFIG_USB_EHCI_HCD=y
CONFIG_USB_EHCI_GENERIC=y
CONFIG_USB_STORAGE=y
CONFIG_WATCHDOG=y
CONFIG_WDT=y
CONFIG_WDT_MT7621=y
# CONFIG_USE_PRIVATE_LIBGCC is not set
CONFIG_LZMA=y

# Turning these off causes u-boot not to boot.  Not sure why
###CONFIG_SERIAL_PRESENT=n
###CONFIG_SPL_SERIAL_PRESENT=n
###CONFIG_TPL_SERIAL_PRESENT=n
###CONFIG_SYS_NS16550=n

# Note that CONFIG_SILENT_CONSOLE and CONFIG_SILENT_U_BOOT_ONLY rely on "silent=y" being
# set in the environment to be useful.  See sundial_env.base.
CONFIG_SILENT_CONSOLE=y
CONFIG_SILENT_U_BOOT_ONLY=y

# Turn off, on, and change the following if you really want to go in and poke around,
# but there's not a whole lot you can do.
CONFIG_BOOTDELAY=-2
###CONFIG_BOOTDELAY=2
###CONFIG_AUTOBOOT_KEYED=y
###CONFIG_AUTOBOOT_PROMPT="Autoboot in %d seconds\n"
###CONFIG_AUTOBOOT_STOP_STR=" "
```

## recipes-kernel/linux/files/v4.14.115/fit-image-factory.its
```
/dts-v1/;
/* This should look very similar to fit-image.its.
 * We don't include a ramdisk (yet) in the factory image,
 * and we sign the factory image with factory-csk instead of
 * DEV-DD-CodeSigningCertC.cer.prikey.
 */
/ {
        description = "Daredevil Factory Linux Image";
        #address-cells = <1>;

        images {
                kernel {
                        description = "Linux kernel";
                        data = /incbin/("vmlinux.bin.lzma");
                        type = "kernel";
                        arch = "mips";
                        os = "linux";
                        compression = "lzma";
                        load = <0x80000000>; /* Must match load-$(CONFIG_SOC_MT7620) */
                        entry = <0x80000000>;/* in kernel-source/arch/mips/ralink/Platform */
                        hash {
                                algo = "sha256";
                        };
                };
		fdt {
			description = "Device tree";
			data = /incbin/("device-tree.dtb");
			type = "flat_dt";
			arch = "mips";
			compression = "none";
			fdt-version = <1>;
			hash {
				algo = "sha256";
			};
		};
	};

        configurations {
                default = "conf";
                conf {
			description = "Linux kernel configuration";

			kernel  = "kernel";
			fdt     = "fdt";

			signature {
				sign-images = "kernel", "fdt";
				algo = "sha256,rsa4096";
				key-name-hint = "factory-csk";
				padding = "pkcs-1.5";
			};
                };
	};
};
```

## recipes-kernel/linux/files/v4.14.115/fit-image.its
```
/dts-v1/;

/ {
        description = "Daredevil Linux Image";
        #address-cells = <1>;

        images {
                kernel {
                        description = "Linux kernel";
                        data = /incbin/("vmlinux.bin.lzma");
                        type = "kernel";
                        arch = "mips";
                        os = "linux";
                        compression = "lzma";
                        load = <0x80000000>; /* Must match load-$(CONFIG_SOC_MT7620) */
                        entry = <0x80000000>;/* in kernel-source/arch/mips/ralink/Platform */
                        hash {
                                algo = "sha256";
                        };
                };

		ramdisk {
			description = "initramfs image";
			data = /incbin/("initramfs-sundial.cpio.lzma");
			type = "ramdisk";
			arch = "mips";
			os = "linux";
			compression = "lzma";
			hash {
				algo = "sha256";
			};
		};

		fdt {
			description = "Device tree";
			data = /incbin/("device-tree.dtb");
			type = "flat_dt";
			arch = "mips";
			compression = "none";
			fdt-version = <1>;
			hash {
				algo = "sha256";
			};
		};
	};

        configurations {
                default = "conf";
                conf {
			description = "Linux kernel configuration";

			kernel  = "kernel";
			fdt     = "fdt";
			ramdisk = "ramdisk";

			signature {
				sign-images = "kernel", "fdt", "ramdisk";
				algo = "sha256,rsa4096";
				key-name-hint = "C3OpenSource-CodeSigningKey.pri";
				padding = "pkcs-1.5";
			};
                };
	};
};
```
